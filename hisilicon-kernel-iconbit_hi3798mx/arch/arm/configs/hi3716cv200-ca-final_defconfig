## hisilicon-kernel-iconbit_hi3798mx/arch/arm/mach-s40/Kconfig
```kconfig
menu "S40 board feature"

config MACH_S40
	bool "Support s40 platform"
	select CPU_V7
	select ARM_GIC
	select ARM_TIMER_SP804
	help
	  Include support for the hisilion S40 platform.
	  S40 support ARM CORTEX-A9 processer,
	  within a Generic Interrupt Controller.
	  Support DDR2 and DDR3.

choice
	prompt "CPU timer source"
	default HAVE_SP804_LOCAL_TIMER

config HAVE_SP804_LOCAL_TIMER
	bool "arm local timer from sp804"
	help
	  arm local timer from sp804.

config HAVE_ARM_LOCAL_TIMER
	bool "arm local timer from arm self"
	help
	  arm local timer from arm self.
endchoice

config HI_S40_HZ
	int "Config HZ"
	default 100 if HIGH_RES_TIMERS
	default 100

config DEFAULT_BUSCLK
	int "DEFAULT_BUSCLK"
	default "50000000"
	help
	  Default AHB clock rate

config DEFAULT_UART_BASE_ADDR
	hex "Default uart controller base address"
	default "0xF8B00000"
	help
	  Default UART controller base address

config MMZ_PARAM
	string "MMZ param for CMA and ION"
	depends on CMA
	default "ddr,0,0,320M" if MACH_S40
	help
	  This is the parameter of mmz memory manager, which now is for CMA 
	  and ION memory manager.

	  
config S40_FPGA
	bool "Enable S40 Fpga config"
	default y if ARCH_S40

menuconfig SUPPORT_CA
	bool "Support CA"
	default n
	help
	  If support ca, user privileges will be limit.
	  select y, support ca, otherwise not support ca.

config CA_RUNTIME_CHECK
	bool "Support CA runtime check"
	depends on SUPPORT_CA
	default n
	help
	  support ca runtime check feature

config CA_WARKUP_CHECK
	bool "Support CA wakeup ddr check"
	depends on SUPPORT_CA
	default n
	help
	  support ca suspend get hash value, and wakeup check ddr.

config CA_SUPPORT_ADVCA
	bool "Support advca"
	depends on SUPPORT_CA
	default n
	help
	  support advca, which is the real CA.

menuconfig SUPPORT_DSP_RUN_MEM
	bool "Support DSP run memory"
	default y
	help 
	  Support DSP run memory

config DSP_RUN_MEM_ADDR
	hex "DSP run memory address"
	depends on SUPPORT_DSP_RUN_MEM
	default "0x2000000" 
	help
	  The start address of DSP run memory.

config DSP_RUN_MEM_SIZE
	hex "DSP run memory size"
	depends on SUPPORT_DSP_RUN_MEM
	default "0x800000"
	help
	  The size of DSP run memory.

menuconfig SUPPORT_SRAM_MANAGER
	bool "SRAM manager suppport"
	default n
	select GENERIC_ALLOCATOR
	help
	  If say y, SRAM manager is supported

config SRAM_PHYS_START
	hex "SRAM physical address"
	default "0xFFFF2800"
	depends on SUPPORT_SRAM_MANAGER
	help
	  SRAM physical address

config SRAM_PHYS_SIZE
	hex "SRAM size"
	default "0x00002800"
	depends on SUPPORT_SRAM_MANAGER
	help
	  SRAM size

endmenu
```

## hisilicon-kernel-iconbit_hi3798mx/drivers/ata/Kconfig.hiahci
```kconfig
#
# hisata sata ahci device configuration
#

menuconfig HI_SATA
	bool "hisilicon sata device support"
	depends on (ARCH_GODBOX || ARCH_S40 || ARCH_HI3798MX)
	default n if (ARCH_GODBOX  || ARCH_S40 || ARCH_HI3798MX)
	select ATA
	select ATA_VERBOSE_ERROR
	select SATA_PMP
	help
	  This selects the hisilicon sata device.

if HI_SATA

config HI_SATA_IOBASE
	hex "hi sata IO address"
	default "0x60040000" if ARCH_GODBOX
	default "0xF9900000" if (ARCH_S40 || ARCH_HI3798MX)

config HI_SATA_IOSIZE
	hex "hi sata IO size"
	default "0x00010000"
	help
	  default is 0x10000.

config HI_SATA_IRQNUM
	int "hi sata irq number"
	default "92" if ARCH_GODBOX
	default "102" if (ARCH_S40 || ARCH_HI3798MX)

config HI_SATA_PHY_CONFIG
	hex "hi sata phy config for 1.5G"
	default "0x0e03615f" if ARCH_GODBOX
	depends on ARCH_GODBOX
	help
	   SATA Phy config for 1.5G mode.

config HI_SATA_3G_PHY_CONFIG
	hex "hi sata phy config for 3G"
	default "0x0e662753" if ARCH_GODBOX
	depends on ARCH_GODBOX
	help
	   SATA Phy config for 3G mode.

config HI_SATA_MODE
	int "hi sata interworking speed mode(1.5G:0/3G:1)"
	range 0 1
	default "0" if ARCH_GODBOX
	depends on ARCH_GODBOX

config HI_SATA_PORTS
	int "hi sata port number"
	default "1" if ARCH_GODBOX
	depends on ARCH_GODBOX

endif # HI_SATA
```

## hisilicon-kernel-iconbit_hi3798mx/drivers/hisilicon/Kconfig
```kconfig
menu "Hisilicon driver support"

config APP_CAPABLE
	tristate "Application Capable"
	default y
	help
	  Support application have root authority.

endmenu
```

## hisilicon-kernel-iconbit_hi3798mx/drivers/mmc/host/himciv200/Kconfig
```kconfig
#
# himci v200 device configuration
#

menuconfig HIMCIV200_SDIO_SYNOPSYS 
	tristate "himci v200 sdio/mmc device support"
	depends on (ARCH_GODBOX || ARCH_S40 || ARCH_HI3798MX)
	default n if (ARCH_GODBOX || ARCH_S40 || ARCH_HI3798MX)
	select MMC_UNSAFE_RESUME
	select MMC_EMBEDDED_SDIO
	select MMC_BLOCK
	select MMC_BLOCK_BOUNCE
	help
	  This selects the mmc family device.

if HIMCIV200_SDIO_SYNOPSYS 

config HIMCIV200_SDIO0_IOBASE
	hex "himci v200 sdio0 reg base"
	default "0x601C0000" if ARCH_GODBOX
	default "0xF9820000" if (ARCH_S40 || ARCH_HI3798MX)


config HIMCIV200_SDIO0_INTR
	int "himci v200 sdio0 intr number"
	default "98" if ARCH_GODBOX
	default "66" if (ARCH_S40 || ARCH_HI3798MX)

config HIMCIV200_SDIO0_BUS_WIDTH_8
	bool "himci v200 sdio0 bus_width_8_bit support"
	depends on ARCH_GODBOX
	default n if ARCH_GODBOX
	
config HIMCIV200_SDIO1_IOBASE
	hex "himci v200 sdio1 reg base"
	default "0xF9830000" if (ARCH_S40 || ARCH_HI3798MX)

config HIMCIV200_SDIO1_INTR
	int "himci v200 sdio1 intr number"
	default "67" if (ARCH_S40 || ARCH_HI3798MX)

endif
```

## hisilicon-kernel-iconbit_hi3798mx/drivers/mtd/devices/hisfc350/Kconfig
```kconfig
#
# hisilicon spi flash controller device version 350
#

menuconfig MTD_HISFC350
	tristate "hisilicon spi flash controller device version 350 driver"
	depends on ARCH_S40 || ARCH_GODBOX
	default n
	select MTD_SPI_IDS
	help
	  hisilicon spi flash controller device version 350.

if MTD_HISFC350

config HISFC350_SYSCTRL_ADDRESS
	hex "hisfc350 system control register base address"
	default "0xf8a22000" if ARCH_S40
	default "0x101f5000" if ARCH_GODBOX

config HISFC350_BUFFER_BASE_ADDRESS
	hex "hisfc350 read/write memory base address"
	default "0xfa000000" if ARCH_S40
	default "0x26000000" if ARCH_GODBOX

config HISFC350_REG_BASE_ADDRESS
	hex "hisfc350 register base address"
	default "0xf9800000" if ARCH_S40
	default "0x60020000" if ARCH_GODBOX

config HISFC350_CHIP_NUM
	int "hisfc350 spi chip number"
	default 2 if ARCH_S40
	default 2 if ARCH_GODBOX

config HISFC350_SHOW_CYCLE_TIMING
	bool "show spi read/write/erase timing cycle"
	default n
	help
	  Show spi read/write/erase timing cycle, command, clock.

endif # MTD_HISFC350
```

## hisilicon-kernel-iconbit_hi3798mx/drivers/mtd/nand/hinfc504/Kconfig
```kconfig
#
# drivers/mtd/nand/hinfc504/Kconfig
# add by caizhiyong 2010.11.04
#

menuconfig MTD_NAND_HINFC504
	tristate "Hisilicon NAND Controller v504 device Support"
	depends on MTD_NAND
	default y if (ARCH_S40) || (ARCH_GODBOX)
	select YAFFS_FS
	select MISC_FILESYSTEMS
	select MTD_BLOCK
	select YAFFS_YAFFS2
	help
	  Hisilicon NAND Controller v504 device Support

if MTD_NAND_HINFC504

config HINFC504_REG_BASE_ADDRESS
	hex "nand controller's register base address"
	default 0xF9810000 if (ARCH_S40)
	default 0x60010000 if (ARCH_GODBOX)
	help
	  register base address of nand controller

config HINFC504_BUFFER_BASE_ADDRESS
	hex "nand controller's buffer base address"
	default 0xFE000000 if (ARCH_S40)
	default 0x24000000 if (ARCH_GODBOX)
	help
	  buffer base address of nand controller

config HINFC504_PERIPHERY_REGBASE
	hex "nand controller's peripher base address"
	default 0xF8A22000 if (ARCH_S40)
	default 0x101F5000 if (ARCH_GODBOX)
	help
	  peripher base address of nand controller,for clk setting

config HINFC504_MAX_CHIP
	int "number of nand flash chip (1,4)"
	default 1
	help
	  nand controller v504 device only support 1 or 2 nand flash chip,
	  your should not config other value.

config HINFC504_DBG_NAND_DEBUG
	bool "Debug: create debug file to control debug type"
	default y
	help
	  Create "debug" file to control debug type.

config HINFC504_DBG_NAND_DUMP
	bool "Debug: display read/write/erase process nand data"
	depends on HINFC504_DBG_NAND_DEBUG
	default y
	help
	  Create "dump" file dump to display all nand operation and data.

config HINFC504_DBG_NAND_ERASE_COUNT
	bool "Debug: display last erase count"
	depends on HINFC504_DBG_NAND_DEBUG
	default y
	help
	  Create "erase_count" file to display last erase count.

config HINFC504_DBG_NAND_ECC_COUNT
	bool "Debug: display last ecc count."
	depends on HINFC504_DBG_NAND_DEBUG
	default y
	help
	  Create "ecc_count" to display last ecc count.

config HINFC504_DBG_NAND_READ_RETRY
	bool "Debug: display read_retry process"
	depends on HINFC504_DBG_NAND_DEBUG
	default y
	help
	  Create read_retry file to display read_retry process.

choice
	prompt "Pagesize and Ecc Type Select"

config HINFC504_HARDWARE_PAGESIZE_ECC
	bool "Hardware"
	help
	  pagesize and ecc type use hardware config

config HINFC504_AUTO_PAGESIZE_ECC
	bool "Auto"
	help
	  pagesize and ecc type use hardware config

config HINFC504_PAGESIZE_AUTO_ECC_NONE
	bool "Pagesize Auto, Ecc None"
	help
	  select pagesize 2K, ecc none.

endchoice

endif # MTD_NAND_HINFC504
```

## hisilicon-kernel-iconbit_hi3798mx/drivers/net/ethernet/hieth-gmac/Kconfig
```kconfig
#
# higmac family network device configuration
#

menuconfig HIETH_GMAC
	tristate "hieth gmac family network device support"
	depends on (ARCH_S40 || ARCH_HI3516A)
	default y
	help
	  This selects the hieth gmac family network device.

if HIETH_GMAC

config GMAC_NUMS
	int "hieth-gmac gmac nums"
	range 1 2
	default "2"  if (ARCH_S40)
	default "1"  if (ARCH_HI3516A)
	---help---
	 hieth-gmac gmac nums.
	 1: mac0,
	 2: mac0 and mac1.

config HIETH_TAG
	hex "hieth-gmac misc tag"
	default "0x544100ff"
	help
	  This is graceful set phy interface/mdio/phyaddr in kernel.

config ETHADDR_TAG
	hex "hieth-gmac mac address tag"
	default "0x726d6d73"
	help
	  This is graceful set mac address in kernel.

config HIGMAC_IOBASE
	hex "hieth-gmac IO address"
	default "0xf9840000" if ARCH_S40


config HIGMAC_IRQNUM
	int "hieth-gmac irq number"
	default "103" if ARCH_S40

config HIGMAC_PHY0_ADDR
	int "hieth-gmac0 phy addr"
	range 1 31
	default "1"
	help
	  mac0's phy addr.

config HIGMAC_PHY1_ADDR
	int "hieth-gmac1 phy addr"
	range 1 31
	default "2"
	help
	  mac1's phy addr.

config HIGMAC_PHY0_INTERFACE_MODE
	int "hieth-gmac phy0 interface mode"
	range 0 11
	default "1"
	 help
	  hieth-gmac phy0 interface mode.
	  1---MII,
	  5---RMII,
	  6---RGMII.

config HIGMAC_PHY1_INTERFACE_MODE
	int "hieth-gmac phy1 interface mode"
	range 0 11
	default "1"
	help
	  hieth-gmac phy1 interface mode.
	  1---MII,
	  5---RMII,
	  6---RGMII.

config MAC0_PHY_GPIO_RESET
	bool "use gpio to reset mac0's phy"
	default n
	help
	  use gpio to reset mac0's phy.

config MAC0_PHY_RESET_GPIO_BASE
	hex "gpio base address"
	depends on MAC0_PHY_GPIO_RESET
	default "0xF8B22000"

config MAC0_PHY_RESET_GPIO_BIT
	int "gpio bit"
	depends on MAC0_PHY_GPIO_RESET
	range 0 7
	default "5"

config MAC0_PHY_RESET_GPIO_DATA
	int "gpio data"
	depends on MAC0_PHY_GPIO_RESET
	range 0 1
	default "1"
	help
	  to control gpio ouput signal.
	  1 means gpio output 1--0--1
	  0 means gpio output 0--1--0

config MAC1_PHY_GPIO_RESET
	bool "use gpio to reset mac1's phy"
	default n
	help
	  use gpio to reset mac1's phy.

config MAC1_PHY_RESET_GPIO_BASE
	hex "gpio base address"
	depends on MAC1_PHY_GPIO_RESET
	default "0xF8B22000"

config MAC1_PHY_RESET_GPIO_BIT
	int "gpio bit"
	depends on MAC1_PHY_GPIO_RESET
	range 0 7
	default "5"

config MAC1_PHY_RESET_GPIO_DATA
	int "gpio data"
	depends on MAC1_PHY_GPIO_RESET
	range 0 1
	default "1"
	help
	  to control gpio ouput signal.
	  1 means gpio output 1--0--1
	  0 means gpio output 0--1--0

endif # HIETH_GMAC
```

## hisilicon-kernel-iconbit_hi3798mx/drivers/usb/gadget/hi_hs_dev/Kconfig
```kconfig
#
# hisilicon usb2 device controller version 3.00a
#

menuconfig HI_HS_DEVICE
	tristate "hisilicon highspeed device controller version 3.00a driver"
	default n
	select USB_GADGET_DUALSPEED
	select USB_GADGET_SELECTED
	help
	  hisilicon highspeed device controller version 3.00a.

if HI_HS_DEVICE

config HIUSBUDC_REG_BASE_ADDRESS
	hex "hisilicon highspeed device control register base address"
	default "0xf98c0000" if (ARCH_S40 || ARCH_HI3798MX)
	default "0x60180000" if ARCH_GODBOX

config HIUSBUDC_REG_BASE_ADDRESS_LEN
	hex "hisilicon highspeed device control register size length"
	default "0x40000" if (ARCH_S40 || ARCH_HI3798MX)
	default "0x40000" if ARCH_GODBOX

config HIUSBUDC_IRQ_NUMBER
	int "hisilicon highspeed device interrupt number"
	default "100" if (ARCH_S40 || ARCH_HI3798MX)
	default "103" if ARCH_GODBOX
	
config HIUSBUDC_DMA_BUF_LENGTH
	int "hisilicon highspeed device dma buffer length"
	default "512" if (ARCH_S40 || ARCH_HI3798MX)
	default "16384" if ARCH_GODBOX
config HIUSBUDC_PHY_UTMI_BITWIDTH
	int "hisilicon highspeed device phy interface utmi bitwidth"
	default "8" 
endif # HI_HS_DEVICE
```

## hisilicon-kernel-iconbit_hi3798mx/drivers/usb/host/Kconfig.godbox
```kconfig
#
# hiusb Host Controller Drivers
#
comment "hiusb Host Controller Drivers"
	depends on USB

menuconfig HIUSB_HOST
	bool "hiusb(ehci/ohci) family usb host device support"
	depends on (ARCH_GODBOX)
	default y if (ARCH_GODBOX)
	help
	  This selects the usb(ehci/ohci) family usb host device.

if HIUSB_HOST

config HIUSB_EHCI
	bool "hiusb-ehci usb host device support"
	depends on (ARCH_GODBOX)
	default y if (ARCH_GODBOX)

config HIUSB_EHCI_IOBASE
	hex "hiusb-ehci IO address"
	default "0x60080000" if ARCH_GODBOX

config HIUSB_EHCI_IOSIZE
	hex "hiusb-ehci IO size"
	default "0x00010000"
	help
	  default is 0x10000.

config HIUSB_EHCI_IRQNUM
	int "hiusb-ehci irq number"
	default "96" if ARCH_GODBOX

config HIUSB_OHCI
	bool "hiusb-ohci usb host device support"
	depends on (ARCH_GODBOX)
	default y if (ARCH_GODBOX)

config HIUSB_OHCI_IOBASE
	hex "hiusb-ohci IO address"
	default "0x60070000" if ARCH_GODBOX

config HIUSB_OHCI_IOSIZE
	hex "hiusb-ohci IO size"
	default "0x00010000"
	help
	  default is 0x10000.

config HIUSB_OHCI_IRQNUM
	int "hiusb-ohci irq number"
	default "97" if ARCH_GODBOX

endif # HIUSB_HOST
```
